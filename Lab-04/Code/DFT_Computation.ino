float data[75] = {-87.17307638,-109.5495333,11.00037444,163.4286511,199.1497693,123.5660003,56.25558579,11.87495703,-18.97729813,-42.98507139,-49.50432452,-44.95819516,-33.93206642,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-5.472668004,-17.77934267};
float p = 0;
float x[75];
float N = 75;
double w_real[75][75];
double w_imag[75][75];
double X_real[75];
double X_imag[75];
double X_mag_resp[75];
float Pi = 3.14159;
float inex;
float peak;
float PR = 0;

void setup() {
  // put your setup code here, to run once:
  Serial.begin(9600);

}

void loop() 
{

  // Moving Average
  for (int i = 0; i< 75; i++)
  { 
    p = 0;
    if (i<8)
      {for(int k=0; k<i; k++)
        {p += data[i-k];
          }
        }
    else
    {for(int j=0; j<8; j++)
      {
        p += data[i-j];
        }
      }
    x[i] = p;
  }

  ///DFT Computation
  for (int k = 0; k < N; k++)
  { 
    X_real[k] = 0;
    X_imag[k] = 0;
    X_mag_resp[k] = 0;
    
    for(int n = 0; n < N; n++)
    {
      w_real[k][n] = 0;
      w_imag[k][n] = 0;
      w_real[k][n] = cos(2 * Pi * k * n / N);
      w_imag[k][n] = -sin(2 * Pi * k * n / N);
      X_real[k] += x[n] * w_real[k][n];
      X_imag[k] += x[n] * w_imag[k][n];
      X_mag_resp[k] += sqrt(X_real[k] * X_real[k] + X_imag[k] * X_imag[k]);
    }
  }

  //Plotting the Magnitude Response
  for (int n = 0; n < N; n++)
  {
    Serial.println(X_mag_resp[n]);
  }

  //Getting the maximum value
  peak = 0;
  inex = 0;
 
  for (int n = 0; n < N; n++)
  {
    if (peak < X_mag_resp[n])
    {
      peak = X_mag_resp[n];
      inex = n;
    }
   }

  PR = 60 * (N  - inex) * 25 / N;
//  Serial.println(PR);
  
}
  

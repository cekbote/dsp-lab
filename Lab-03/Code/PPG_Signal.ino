float data[2000] = {-148.6621707,-248.3187771,-267.1305467,-264.039437,-268.3502072,-258.1467536,-219.1794221,-281.6557217,-225.8426497,-274.0979379,-279.9389094,-256.8846671,-255.4500465,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-215.9746394,-210.90232};
float test_data[500];
float working_data[1000];
float average = 0;
float average_1 = 0;
float x =0;
float max_val = 0;
float pre_filtered_zero = 0;
float pre_filter_maxima =0;
float post_filtered_zero =0;
float post_filter_maxima =0;
float auto_corr_pre_moving_average[4][500];
float auto_corr_post_moving_average[4][500];

void setup() 
{
    Serial.begin(9600);
}

void loop() 
{
  for(int k = 0; k<4; k++)
  {
    average = 0;
    average_1 = 0; 
    
    for(int p = 500*k; p < 500*(k+1); p++)
    {
      test_data[p - 500*k] = data[p];
      working_data[p - 500*k] = test_data[p - 500*k];
      average_1 += test_data[p - 500*k];   
    }

   // NON FILTERED 
   // Zero Mean
    for(int p =0; p<500; p++)
    {
      working_data[p] -= (average_1/500); 
    } 

    // Autocorr
    for(int i = 0; i < 500; i++)
    {
    x = 0;
    for(int j = i; j < 500; j++)
    {
      x += working_data[j]*working_data[j-i];
      auto_corr_pre_moving_average[k][i] = x; 
     }
    }

    // Zero Crossing
    pre_filtered_zero = 0;
    for(int i =0; i<500; i++)
    {
      if ((auto_corr_pre_moving_average[k][i] * auto_corr_pre_moving_average[k][i+1]) <0)
      {
        pre_filtered_zero = i+1;
        break;}
      }
    
    // 2nd Maxima
    max_val = 0;
    for(int i=pre_filtered_zero; i<500; i++)
    {
      if(max_val <auto_corr_pre_moving_average[k][i])
      {
        max_val = auto_corr_pre_moving_average[k][i];
        pre_filter_maxima = i;
       }
     }

    
    // FILTERED
    // Moving Average
    for (int i = 0; i< 500; i++)
    { 
    x = 0;
    if (i<8)
      {for(int k=0; k<i; k++)
        {x += test_data[i-k]; 
          }
        }
    else
    {for(int j=0; j<8; j++)
      {
        x += test_data[i-j];
        }
      }
    working_data[i] = x/8;
    average+= working_data[i];
    }
    
    // Zero Mean
    for(int p =0; p<500; p++)
    {
      working_data[p] -= (average/500); 
    }

    // Autocorr
    for(int i = 0; i < 500; i++)
    {
    x = 0;
    for(int j = i; j < 500; j++)
    {
      x += working_data[j]*working_data[j-i];
     }
     auto_corr_post_moving_average[k][i] = x;
     }

    // Zero Crossing
    post_filtered_zero = 0;
    for(int i =0; i<500; i++)
    {
      if ((auto_corr_post_moving_average[k][i] * auto_corr_post_moving_average[k][i+1]) <0)
      {
        post_filtered_zero = i+1;
        break;}
      }
    
    // 2nd Maxima
    max_val = 0;
    for(int i=post_filtered_zero; i<500; i++)
    {
      if(max_val <auto_corr_post_moving_average[k][i])
      {
        max_val = auto_corr_post_moving_average[k][i];
        post_filter_maxima = i;
       }
     }

    // Printing
    for (int i =0; i< 500; i++)
    {
//     Serial.print(k);
//     Serial.print(',');
     Serial.print(auto_corr_pre_moving_average[k][i]/auto_corr_pre_moving_average[k][0]);
     Serial.print(',');
     Serial.println(auto_corr_post_moving_average[k][i]/auto_corr_post_moving_average[k][0]);
//     Serial.print(',');
//     Serial.print(pre_filter_maxima/100.0);
//     Serial.print(',');
//     Serial.print(post_filter_maxima/100.0);
//     Serial.print(',');
//     Serial.print(60/(pre_filter_maxima/100.0));
//     Serial.print(',');
//     Serial.println(60/(post_filter_maxima/100.0)); 
     }   
  }
}
